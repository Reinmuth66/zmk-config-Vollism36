## boards/shields/Vollism36/Kconfig.shield
```kconfig
config SHIELD_VOLLISM36_R
    def_bool $(shields_list_contains,Vollism36_R)
    
config SHIELD_VOLLISM36_L
    def_bool $(shields_list_contains,Vollism36_L)
```
